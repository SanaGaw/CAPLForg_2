/*!
 * BCM Test Template
 *
 * Configuration: BCM (Body Control Module)
 * Bus Type: CAN
 * ECU: BCM
 *
 * Generated by CAPL Pipeline V2.2
 */

#include <helpers.cin>
#include "constants.cin"

variables {
    {% for signal in signals %}
    {% if signal.data_type == 'unsigned' %}
    byte g_{{ signal.name }};
    {% else %}
    int g_{{ signal.name }};
    {% endif %}
    {% endfor %}
}

/*! Test Case: {{ test_case_id }}
 *  Description: {{ description }}
 */

void Test_{{ test_case_id | replace("-", "_") | replace(".", "_") }}(void) {
    {% for step in test_steps %}
    testStep("{{ step.step_id }}", "{{ step.action }}");
    {% if step.signal %}
    {% if step.action_type == 'set' %}
    putValue({{ step.env_var }}, ${{ step.signal }});
    {% elif step.action_type == 'check' %}
    if ({{ step.env_var }} != ${{ step.signal }}) {
        TestReportAddFailure("{{ step.description }}");
    }
    {% endif %}
    {% endif %}
    {% endfor %}
}
