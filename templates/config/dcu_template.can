/*!
 * DCU Test Template
 *
 * Configuration: DCU (Display Control Unit)
 * Bus Type: CAN
 * ECU: DCU
 *
 * Generated by CAPL Pipeline V2.2
 */

#include <helpers.cin>
#include "constants.cin"

variables {
    message BCM_DoorLock g_BcmDoorLock;
}

/*! Test Case: {{ test_case_id }}
 *  Description: {{ description }}
 */

void Test_{{ test_case_id | replace("-", "_") | replace(".", "_") }}(void) {
    {% for step in test_steps %}
    testStep("{{ step.step_id }}", "{{ step.action }}");
    {% if step.signal and step.env_var %}
    putValue({{ step.env_var }}, ${{ step.signal }});
    testWaitForTimeout(100);
    {% endif %}
    {% endfor %}
}
